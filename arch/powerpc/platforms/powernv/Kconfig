## arch/powerpc/platforms/powernv/Kconfig
```kconfig
# SPDX-License-Identifier: GPL-2.0
config PPC_POWERNV
	depends on PPC64 && PPC_BOOK3S
	bool "IBM PowerNV (Non-Virtualized) platform support"
	select PPC_NATIVE
	select PPC_XICS
	select PPC_ICP_NATIVE
	select PPC_XIVE_NATIVE
	select PPC_P7_NAP
	select HAVE_PCI
	select PCI_MSI if PCI
	select EPAPR_BOOT
	select PPC_INDIRECT_PIO
	select PPC_UDBG_16550
	select PPC_SCOM
	select ARCH_RANDOM
	select CPU_FREQ
	select PPC_DOORBELL
	select MMU_NOTIFIER
	select FORCE_SMP
	default y

config OPAL_PRD
	tristate 'OPAL PRD driver'
	depends on PPC_POWERNV
	help
	  This enables the opal-prd driver, a facility to run processor
	  recovery diagnostics on OpenPower machines

config PPC_MEMTRACE
	bool "Enable removal of RAM from kernel mappings for tracing"
	depends on PPC_POWERNV && MEMORY_HOTREMOVE
	help
	  Enabling this option allows for the removal of memory (RAM)
	  from the kernel mappings to be used for hardware tracing.

config PPC_VAS
	bool "IBM Virtual Accelerator Switchboard (VAS)"
	depends on PPC_POWERNV && PPC_64K_PAGES
	default y
	help
	  This enables support for IBM Virtual Accelerator Switchboard (VAS).

	  VAS allows accelerators in co-processors like NX-GZIP and NX-842
	  to be accessible to kernel subsystems and user processes.

	  VAS adapters are found in POWER9 based systems.

	  If unsure, say N.

config OPAL_PSR
	tristate 'OPAL Power Shift Ratio sysfs interface'
	depends on PPC_POWERNV
	default y if PPC_POWERNV
	help
	  This enables the OPAL Power Shift Ratio (PSR) controls in sysfs.
	  This lets an administrator tune what elements of a system are
	  throttled in the event of power or thermal limits being hit.
	  For example, you may prefer to throttle a CPU more than a GPU.

config OPAL_POWERCAP
	tristate 'OPAL Power Cap sysfs interface'
	depends on PPC_POWERNV
	default y if PPC_POWERNV
	help
	  This enables the OPAL Power Cap controls in sysfs.
	  This lets an administrator tune the maximum amount of power a
	  system is allowed to draw.

config OPAL_SENSOR_GROUPS
	tristate 'OPAL Sensor Groups'
	depends on PPC_POWERNV
	default y if PPC_POWERNV
	help
	  This enables OPAL Sensor Group controls.

config OPAL_FLASH_UPDATE
	tristate 'OPAL Flash Update (for FSP systems)'
	depends on PPC_POWERNV
	default y if PPC_POWERNV
	help
	  This enables flash update for IBM FSP based systems.
```

## arch/powerpc/sysdev/xive/Kconfig
```kconfig
# SPDX-License-Identifier: GPL-2.0
config PPC_XIVE
	bool 'Support for XIVE interrupt controller (POWER9 and later)'
	default y if PPC_POWERNV
	select PPC_SMP_MUXED_IPI
	select HARDIRQS_SW_RESEND

config PPC_XIVE_NATIVE
	bool 'Support for XIVE interrupt controller on powernv'
	default y if PPC_POWERNV
	select PPC_XIVE
	depends on PPC_POWERNV
	help
          POWERNV platforms can use XIVE natively or XICS-on-XIVE emulation
	  provided by OPAL firmware.

config PPC_XIVE_SPAPR
	bool 'Support for XIVE interrupt controller on pseries'
	select PPC_XIVE
	help
```
